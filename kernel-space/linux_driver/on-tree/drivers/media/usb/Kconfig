## kernel-space/linux_driver/on-tree/drivers/media/usb/Kconfig
```kconfig
# SPDX-License-Identifier: GPL-2.0-only

if USB && MEDIA_SUPPORT

menuconfig MEDIA_USB_SUPPORT
	bool "Media USB Adapters"
	help
	  Enable media drivers for USB bus.
	  If you have such devices, say Y.

if MEDIA_USB_SUPPORT

if MEDIA_CAMERA_SUPPORT
	comment "Webcam devices"

...

source "drivers/media/usb/useeplus/Kconfig"

...

endif

if MEDIA_ANALOG_TV_SUPPORT
	comment "Analog TV USB devices"

...

endif

if (MEDIA_ANALOG_TV_SUPPORT || MEDIA_DIGITAL_TV_SUPPORT)
	comment "Analog/digital TV USB devices"

...

endif

if I2C && MEDIA_DIGITAL_TV_SUPPORT
	comment "Digital TV USB devices"

...

endif

if (MEDIA_CAMERA_SUPPORT || MEDIA_ANALOG_TV_SUPPORT || MEDIA_DIGITAL_TV_SUPPORT)
	comment "Webcam, TV (analog/digital) USB devices"

...

endif

if MEDIA_SDR_SUPPORT
	comment "Software defined radio USB devices"

...

endif

endif #MEDIA_USB_SUPPORT
endif #USB
```

## kernel-space/linux_driver/on-tree/drivers/media/usb/useeplus/Kconfig
```kconfig
# SPDX-License-Identifier: MIT OR GPL-2.0-only
config USB_USEEPLUS
	tristate "Useeplus Protocol USB Camera support"
	depends on VIDEO_DEV && USB
	select VIDEOBUF2_VMALLOC
	help
	  Choose Y or M here to support non-UVC USB cameras utilizing
	  the Useeplus proprietary protocol.

	  To compile this driver as a module, choose M here: the module will be called useeplus
```
